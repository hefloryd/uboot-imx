## board/arb/arb2/Kconfig
```kconfig
if TARGET_ARB2

config SYS_BOARD
	default "arb2"

config SYS_VENDOR
	default "arb"

config SYS_CONFIG_NAME
	default "arb2"

endif
```

## configs/arb2_defconfig
```kconfig
CONFIG_ARM=y
CONFIG_ARCH_MX6=y
CONFIG_TARGET_ARB2=y
CONFIG_SYS_EXTRA_OPTIONS="IMX_CONFIG=board/arb/arb2/arb2.cfg,MX6DL,SYS_BOOT_EIMNOR"
CONFIG_CMD_GPIO=y
```
